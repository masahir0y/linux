## Documentation/devicetree/bindings/arm/uniphier.txt
```
Socionext UniPhier SoC family

Required properties in the root node:
  - compatible: should contain board and SoC compatible strings

    SoC compatibles:
      - "socionext,uniphier-ld4"   - LD4 SoC
      - "socionext,uniphier-pro4"  - Pro4 SoC
      - "socionext,uniphier-sld8"  - sLD8 SoC
      - "socionext,uniphier-pro5"  - Pro5 SoC
      - "socionext,uniphier-pxs2"  - PXs2 SoC
      - "socionext,uniphier-ld6b"  - LD6b SoC
      - "socionext,uniphier-ld11"  - LD11 SoC
      - "socionext,uniphier-ld20"  - LD20 SoC
      - "socionext,uniphier-pxs3"  - PXs3 SoC

    Board compatibles:
      - "socionext,uniphier-ld4-ref"      - LD4 Reference Board
      - "socionext,uniphier-pro4-ref"     - Pro4 Reference Board
      - "socionext,uniphier-pro4-ace"     - Pro4 Ace Board
      - "socionext,uniphier-pro4-sanji"   - Pro4 Sanji Board
      - "socionext,uniphier-sld8-ref"     - sLD8 Reference Board
      - "socionext,uniphier-pxs2-gentil"  - PXs2 Gentil Board
      - "socionext,uniphier-pxs2-vodka"   - PXs2 Vodka Board
      - "socionext,uniphier-ld6b-ref"     - LD6b Reference Board
      - "socionext,uniphier-ld11-ref"     - LD11 Reference Board
      - "socionext,uniphier-ld11-global"  - LD11 Global Board
      - "socionext,uniphier-ld20-ref"     - LD20 Reference Board
      - "socionext,uniphier-ld20-global"  - LD20 Global Board
      - "socionext,uniphier-pxs3-ref"     - PXs3 Reference Board

Example:

/dts-v1/;

/ {
	compatible = "socionext,uniphier-ld20-ref", "socionext,uniphier-ld20";

	...
};
```

## Documentation/devicetree/bindings/clock/zynq-7000.txt
```
Device Tree Clock bindings for the Zynq 7000 EPP

The Zynq EPP has several different clk providers, each with there own bindings.
The purpose of this document is to document their usage.

See clock_bindings.txt for more information on the generic clock bindings.
See Chapter 25 of Zynq TRM for more information about Zynq clocks.

== Clock Controller ==
The clock controller is a logical abstraction of Zynq's clock tree. It reads
required input clock frequencies from the devicetree and acts as clock provider
for all clock consumers of PS clocks.

Required properties:
 - #clock-cells : Must be 1
 - compatible : "xlnx,ps7-clkc"
 - reg : SLCR offset and size taken via syscon < 0x100 0x100 >
 - ps-clk-frequency : Frequency of the oscillator providing ps_clk in HZ
		      (usually 33 MHz oscillators are used for Zynq platforms)

Optional properties:
 - clocks : as described in the clock bindings
 - clock-names : as described in the clock bindings
 - fclk-enable : Bit mask to enable FCLKs statically at boot time.
		 Bit [0..3] correspond to FCLK0..FCLK3. The corresponding
		 FCLK will only be enabled if it is actually running at
		 boot time.

Clock inputs:
The following strings are optional parameters to the 'clock-names' property in
order to provide an optional (E)MIO clock source.
 - swdt_ext_clk
 - gem0_emio_clk
 - gem1_emio_clk
 - mio_clk_XX		# with XX = 00..53
...

Clock outputs:
 0:  armpll
 1:  ddrpll
 2:  iopll
 3:  cpu_6or4x
 4:  cpu_3or2x
 5:  cpu_2x
 6:  cpu_1x
 7:  ddr2x
 8:  ddr3x
 9:  dci
 10: lqspi
 11: smc
 12: pcap
 13: gem0
 14: gem1
 15: fclk0
 16: fclk1
 17: fclk2
 18: fclk3
 19: can0
 20: can1
 21: sdio0
 22: sdio1
 23: uart0
 24: uart1
 25: spi0
 26: spi1
 27: dma
 28: usb0_aper
 29: usb1_aper
 30: gem0_aper
 31: gem1_aper
 32: sdio0_aper
 33: sdio1_aper
 34: spi0_aper
 35: spi1_aper
 36: can0_aper
 37: can1_aper
 38: i2c0_aper
 39: i2c1_aper
 40: uart0_aper
 41: uart1_aper
 42: gpio_aper
 43: lqspi_aper
 44: smc_aper
 45: swdt
 46: dbg_trc
 47: dbg_apb

Example:
	clkc: clkc@100 {
		#clock-cells = <1>;
		compatible = "xlnx,ps7-clkc";
		ps-clk-frequency = <33333333>;
		reg = <0x100 0x100>;
		# optional props
		clocks = <&clkc 16>, <&clk_foo>;
		clock-names = "gem1_emio_clk", "can_mio_clk_23";
	};
```

## Documentation/devicetree/bindings/gpio/gpio-uniphier.txt
```
UniPhier GPIO controller

Required properties:
- compatible: should be "socionext,uniphier-gpio".
- reg: offset and length of the register set for the device.
- gpio-controller: marks the device node as a GPIO controller.
- #gpio-cells: should be three.
    The 1st cell is the bank number.
    The 2nd cell is the line number in the bank.
    The 3rd cell is the flags.
- gpio-banks: the number of GPIO banks.

Optional properties:
- gpio-ranges: interaction with the pinctrl device.  See gpio.txt
- gpio-ranges-group-names: interaction with the pinctrl device.  See gpio.txt

Example:
	gpio: gpio@55000000 {
		compatible = "socionext,uniphier-gpio";
		reg = <0x55000000 0x200>;
		gpio-controller;
		#gpio-cells = <3>;
		gpio-ranges = <&pinctrl 0 0 0>;
		gpio-ranges-group-names = "port_range";
		gpio-banks = <26>;
	};
```

## Documentation/devicetree/bindings/mtd/denali-nand.txt
```
* Denali NAND controller

Required properties:
  - compatible : should be one of the following:
      "altera,denali-nand"
  - reg : should contain registers location and length for data and reg.
  - reg-names: Should contain the reg names "nand_data" and "denali_reg"
  - interrupts : The interrupt number.

Optional properties:
  - nand-ecc-step-size: must be 512 or 1024.  If not specified, default to:
      512  for "altera,denali-nand"
    see nand.txt for details.
  - nand-ecc-strength: see nand.txt for details
  - nand-ecc-maximize: see nand.txt for details

Note:
Either nand-ecc-strength or nand-ecc-maximize should be specified.

The device tree may optionally contain sub-nodes describing partitions of the
address space. See partition.txt for more detail.

Examples:

nand: nand@ff900000 {
	#address-cells = <1>;
	#size-cells = <1>;
	compatible = "denali,denali-nand-dt";
	reg = <0xff900000 0x100000>, <0xffb80000 0x10000>;
	reg-names = "nand_data", "denali_reg";
	interrupts = <0 144 4>;
};
```

## Documentation/devicetree/bindings/pinctrl/socionext,uniphier-pinctrl.txt
```
UniPhier SoCs pin controller

Required properties:
- compatible: should be one of the followings:
	"socionext,ph1-ld4-pinctrl"	(PH1-LD4)
	"socionext,ph1-ld6b-pinctrl"	(PH1-LD6b)
	"socionext,ph1-pro4-pinctrl"	(PH1-Pro4)
	"socionext,ph1-pro5-pinctrl"	(PH1-Pro5)
	"socionext,ph1-sld8-pinctrl"	(PH1-sLD8)
	"socionext,proxstream2-pinctrl"	(ProXstream2)
- reg: offset and length of the register set for the device.

	pinctrl: pinctrl@5f801000 {
		compatible = "socionext,ph1-pro4-pinctrl", "syscon";
		reg = <0x5f801000 0xe00>;
	};
```

## Kconfig
```kconfig
config MODULES
       def_bool y
       option modules

config INT
       int "test int"

config STR
       string "test string"

config FOO
       tristate "foo"

choice
	prompt "hoge"

config AAA
       tristate "aaa"

config BBB
       tristate "bbb"

endchoice

menuconfig GGG
	   bool "ggg"

if GGG

config CCC
       tristate "ccc"

endif
```

## arch/arm/Kconfig.platforms
```kconfig
# SPDX-License-Identifier: GPL-2.0
menuconfig ARCH_ASPEED
	bool "Aspeed BMC architectures"
	depends on ARCH_MULTI_V5 || ARCH_MULTI_V6
	select SRAM
	select WATCHDOG
	select ASPEED_WATCHDOG
	select FTTMR010_TIMER
	select MFD_SYSCON
	select PINCTRL
	help
	  Say Y here if you want to run your kernel on an ASpeed BMC SoC.

if ARCH_ASPEED

config MACH_ASPEED_G4
	bool "Aspeed SoC 4th Generation"
	depends on ARCH_MULTI_V5
	select CPU_ARM926T
	select PINCTRL_ASPEED_G4
	help
	 Say yes if you intend to run on an Aspeed ast2400 or similar
	 fourth generation BMCs, such as those used by OpenPower Power8
	 systems.

config MACH_ASPEED_G5
	bool "Aspeed SoC 5th Generation"
	depends on ARCH_MULTI_V6
	select CPU_V6
	select PINCTRL_ASPEED_G5
	help
	 Say yes if you intend to run on an Aspeed ast2500 or similar
	 fifth generation Aspeed BMCs.

endif

config ARCH_DIGICOLOR
	bool "Conexant Digicolor SoC Support"
	depends on ARCH_MULTI_V7
	select CLKSRC_MMIO
	select DIGICOLOR_TIMER
	select GENERIC_IRQ_CHIP
	select GPIOLIB
	select MFD_SYSCON
	select PINCTRL
	select PINCTRL_DIGICOLOR

menuconfig ARCH_MOXART
	bool "MOXA ART SoC"
	depends on ARCH_MULTI_V4
	select CPU_FA526
	select ARM_DMA_MEM_BUFFERABLE
	select FARADAY_FTINTC010
	select FTTMR010_TIMER
	select GPIOLIB
	select PHYLIB if NETDEVICES
	help
	  Say Y here if you want to run your kernel on hardware with a
	  MOXA ART SoC.
	  The MOXA ART SoC is based on a Faraday FA526 ARMv4 32-bit
	  192 MHz CPU with MMU and 16KB/8KB D/I-cache (UC-7112-LX).
	  Used on models UC-7101, UC-7112/UC-7110, IA240/IA241, IA3341.

if ARCH_MOXART

config MACH_UC7112LX
	bool "MOXA UC-7112-LX"
	depends on ARCH_MOXART
	help
	  Say Y here if you intend to run this kernel on a MOXA
	  UC-7112-LX embedded computer.

endif

config ARCH_UNIPHIER
	bool "Socionext UniPhier SoCs"
	depends on ARCH_MULTI_V7
	select ARCH_HAS_RESET_CONTROLLER
	select ARM_AMBA
	select ARM_GLOBAL_TIMER
	select ARM_GIC
	select HAVE_ARM_SCU
	select HAVE_ARM_TWD
	select PINCTRL
	help
	  Support for UniPhier SoC family developed by Socionext Inc.
	  (formerly, System LSI Business Division of Panasonic Corporation)

config MACH_ASM9260
	bool "Alphascale ASM9260"
	depends on ARCH_MULTI_V5
	select CPU_ARM926T
	select ASM9260_TIMER
	select GENERIC_CLOCKEVENTS
	help
	  Support for Alphascale ASM9260 based platform.
```

## scripts/kconfig/tests/Kconfig.choice
```kconfig
config MODULES
	bool "module support"
	option modules

choice
	prompt "boolean choice test"

config BOOL_CHOICE_VAL1
	bool "choice 1"

config BOOL_CHOICE_VAL2
	bool "choice 2"

endchoice

choice
	prompt "tristate choice test"

config TRISTATE_CHOICE_VAL1
	tristate "choice 1"

config TRISTATE_CHOICE_VAL2
	tristate "choice 2"

endchoice
```

## scripts/kconfig/tests/revdep_with_tristate_if/Kconfig
```kconfig
# SPDX-License-Identifier: GPL-2.0

config MODULES
	def_bool y
	option modules

config A
	tristate

config B
	tristate "b"
	default y
	select A if C
	imply D if C

config C
	tristate "c"
	default m

config D
	tristate "d"
```
